## conf/distro/sofia.conf
```bitbake
require conf/distro/poky.conf

DISTRO = "sofia"
DISTRO_NAME = "SofiaTech Yocto Distribution"
DISTRO_VERSION = "1.0"

MAINTAINER = "maintainer@sofiatech.com"

# In order to work for 3B+ as well
DISABLE_VC4GRAPHICS_raspberrypi3 = "1"

# Use Systemd on all machines
DISTRO_FEATURES_append = " systemd"
VIRTUAL-RUNTIME_init_manager = "systemd"
DISTRO_FEATURES_BACKFILL_CONSIDERED = "sysvinit"
VIRTUAL-RUNTIME_initscripts = ""
```
